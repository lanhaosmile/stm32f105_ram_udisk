/* USER CODE BEGIN Header */
/**
  ******************************************************************************
  * @file           : usbd_storage_if.c
  * @version        : v2.0_Cube
  * @brief          : Memory management layer.
  ******************************************************************************
  * @attention
  *
  * <h2><center>&copy; Copyright (c) 2019 STMicroelectronics.
  * All rights reserved.</center></h2>
  *
  * This software component is licensed by ST under Ultimate Liberty license
  * SLA0044, the "License"; You may not use this file except in compliance with
  * the License. You may obtain a copy of the License at:
  *                             www.st.com/SLA0044
  *
  ******************************************************************************
  */
/* USER CODE END Header */

/* Includes ------------------------------------------------------------------*/
#include "usbd_storage_if.h"
#include "stm32f1xx_hal_flash.h"

/* USER CODE BEGIN INCLUDE */
#include "main.h"
/* USER CODE END INCLUDE */

/* Private typedef -----------------------------------------------------------*/
/* Private define ------------------------------------------------------------*/
/* Private macro -------------------------------------------------------------*/

/* USER CODE BEGIN PV */
/* Private variables ---------------------------------------------------------*/

/* USER CODE END PV */

/** @addtogroup STM32_USB_OTG_DEVICE_LIBRARY
  * @brief Usb device.
  * @{
  */

/** @defgroup USBD_STORAGE
  * @brief Usb mass storage device module
  * @{
  */

/** @defgroup USBD_STORAGE_Private_TypesDefinitions
  * @brief Private types.
  * @{
  */

/* USER CODE BEGIN PRIVATE_TYPES */

/* USER CODE END PRIVATE_TYPES */

/**
  * @}
  */

/** @defgroup USBD_STORAGE_Private_Defines
  * @brief Private defines.
  * @{
  */

#define STORAGE_LUN_NBR                   1
#define STORAGE_BLK_NBR                   100		//512*100 = 50K
#define STORAGE_BLK_SIZ                   512	  //512

#define RAMDISK_BLK_NBR										100
#define RAMDISK_BLK_SIZ										512
#define RAMDISK_SIZE    									RAMDISK_BLK_NBR*RAMDISK_BLK_SIZ
/* USER CODE BEGIN PRIVATE_DEFINES */

/* USER CODE END PRIVATE_DEFINES */

/**
  * @}
  */

/** @defgroup USBD_STORAGE_Private_Macros
  * @brief Private macros.
  * @{
  */

/* USER CODE BEGIN PRIVATE_MACRO */

/* USER CODE END PRIVATE_MACRO */

/**
  * @}
  */

/** @defgroup USBD_STORAGE_Private_Variables
  * @brief Private variables.
  * @{
  */

/* USER CODE BEGIN INQUIRY_DATA_FS */
/** USB Mass storage Standard Inquiry Data. */
const int8_t STORAGE_Inquirydata_FS[] = {/* 36 */
  
  /* LUN 0 */
  0x00,
  0x80,
  0x02,
  0x02,
  (STANDARD_INQUIRY_DATA_LEN - 5),
  0x00,
  0x00,	
  0x00,
  'S', 'T', 'M', ' ', ' ', ' ', ' ', ' ', /* Manufacturer : 8 bytes */
  'P', 'r', 'o', 'd', 'u', 'c', 't', ' ', /* Product      : 16 Bytes */
  ' ', ' ', ' ', ' ', ' ', ' ', ' ', ' ',
  '0', '.', '0' ,'1'                      /* Version      : 4 Bytes */
}; 
/* USER CODE END INQUIRY_DATA_FS */

/* USER CODE BEGIN PRIVATE_VARIABLES */

/* USER CODE END PRIVATE_VARIABLES */

/**
  * @}
  */

/** @defgroup USBD_STORAGE_Exported_Variables
  * @brief Public variables.
  * @{
  */

extern USBD_HandleTypeDef hUsbDeviceFS;

/* USER CODE BEGIN EXPORTED_VARIABLES */

/* USER CODE END EXPORTED_VARIABLES */

/**
  * @}
  */

/** @defgroup USBD_STORAGE_Private_FunctionPrototypes
  * @brief Private functions declaration.
  * @{
  */

static int8_t STORAGE_Init_FS(uint8_t lun);
static int8_t STORAGE_GetCapacity_FS(uint8_t lun, uint32_t *block_num, uint16_t *block_size);
static int8_t STORAGE_IsReady_FS(uint8_t lun);
static int8_t STORAGE_IsWriteProtected_FS(uint8_t lun);
static int8_t STORAGE_Read_FS(uint8_t lun, uint8_t *buf, uint32_t blk_addr, uint16_t blk_len);
static int8_t STORAGE_Write_FS(uint8_t lun, uint8_t *buf, uint32_t blk_addr, uint16_t blk_len);
static int8_t STORAGE_GetMaxLun_FS(void);

/* USER CODE BEGIN PRIVATE_FUNCTIONS_DECLARATION */

/* USER CODE END PRIVATE_FUNCTIONS_DECLARATION */
uint32_t   Mass_Block_Count;

uint8_t msc_data[RAMDISK_BLK_NBR][RAMDISK_BLK_SIZ]={0};

static const uint8_t FAT_DBR_TABLE[]=
{
0xEB,0x3C,0x90,0x4D,0x53,0x44,0x4F,0x53,0x35,0x2E,0x30,0x00,0x02,0x01,0x04,0x00,
0x02,0x00,0x02,0xF8,0x01,0xF8,0x02,0x00,0x01,0x00,0x01,0x00,0x00,0x00,0x00,0x00,
0x00,0x00,0x00,0x00,0x80,0x00,0x29,0x9C,0xF8,0x5B,0x50,0x4E,0x4F,0x20,0x4E,0x41,
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0x72,0x74,0x0D,0x0A,0x00,0x00,0x00,0x00,0x00,0x00,0x00,0xAC,0xCB,0xD8,0x55,0xAA
//0x800 = F8 FF FF 03 40 00 05 F0 FF
//0xC00 = F8 FF FF 03 40 00 05 F0 FF
};


static const uint8_t FAT_FILE_NAME[]=
{//offect 0x1000
0x42,0x69,0x00,0x76,0x00,0x65,0x00,0x72,0x00,0x2E,0x00,0x0F,0x00,0x61,0x69,0x00,
0x6E,0x00,0x66,0x00,0x00,0x00,0xFF,0xFF,0xFF,0xFF,0x00,0x00,0xFF,0xFF,0xFF,0xFF,
0x01,0x59,0x00,0x61,0x00,0x6E,0x00,0x48,0x00,0x75,0x00,0x0F,0x00,0x61,0x61,0x00,
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0x00,0x00,0x00,0x00,0x00,0x00,0x6F,0x8C,0x29,0x47  
};

static const uint8_t FAT_FILE_DATA[]=
{//offect 0x5000
0x3B,0x2D,0x2D,0x2D,0x2D,0x2D,0x2D,0x2D,0x2D,0x2D,0x2D,0x2D,0x2D,0x2D,0x2D,0x2D,
0x2D,0x2D,0x2D,0x2D,0x2D,0x2D,0x2D,0x2D,0x2D,0x2D,0x2D,0x2D,0x2D,0x2D,0x2D,0x2D,
0x2D,0x2D,0x2D,0x2D,0x2D,0x2D,0x2D,0x2D,0x2D,0x2D,0x2D,0x2D,0x2D,0x2D,0x2D,0x2D,
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0x72,0x73,0x20,0x44,0x69,0x73,0x6B,0x22,0x20,0x00,0x00,0x00,0x00,0x00,0x00,0x00 
};

/**
  * @}
  */

USBD_StorageTypeDef USBD_Storage_Interface_fops_FS =
{
  STORAGE_Init_FS,
  STORAGE_GetCapacity_FS,
  STORAGE_IsReady_FS,
  STORAGE_IsWriteProtected_FS,
  STORAGE_Read_FS,
  STORAGE_Write_FS,
  STORAGE_GetMaxLun_FS,
  (int8_t *)STORAGE_Inquirydata_FS
};

/* Private functions ---------------------------------------------------------*/
/**
  * @brief  Initializes over USB FS IP
  * @param  lun:
  * @retval USBD_OK if all operations are OK else USBD_FAIL
  */
int8_t STORAGE_Init_FS(uint8_t lun)
{
  /* USER CODE BEGIN 2 */
	 uint16_t r,c=0;
	 uint32_t i;
   for(i=0;i<sizeof(FAT_DBR_TABLE);i++)
   {
		 r= i/RAMDISK_BLK_SIZ;	//512
		 c= i%RAMDISK_BLK_SIZ;	//64
     msc_data[r][c] = FAT_DBR_TABLE[i];
   } 
	/*	 
	 for(i=0;i<sizeof(FAT_FILE_NAME);i++)   
	 {
		 r= (i+0x1000)/RAMDISK_BLK_SIZ;	//512
		 c= (i+0x1000)%RAMDISK_BLK_SIZ;	//64
     msc_data[r][c] =FAT_FILE_NAME[i];
   }
   for(i=0;i<sizeof(FAT_FILE_DATA);i++)
   {
		 r= (i+0x5000)/RAMDISK_BLK_SIZ;	//512
		 c= (i+0x5000)%RAMDISK_BLK_SIZ;	//64
     msc_data[r][c] =FAT_FILE_DATA[i];
   }
	*/   
	 
   msc_data[0x800/RAMDISK_BLK_SIZ][0x800%RAMDISK_BLK_SIZ]=0xF8;
   msc_data[0x801/RAMDISK_BLK_SIZ][0x801%RAMDISK_BLK_SIZ]=0xFF;
   msc_data[0x802/RAMDISK_BLK_SIZ][0x802%RAMDISK_BLK_SIZ]=0xFF;
   msc_data[0x803/RAMDISK_BLK_SIZ][0x803%RAMDISK_BLK_SIZ]=0x03;
   msc_data[0x804/RAMDISK_BLK_SIZ][0x804%RAMDISK_BLK_SIZ]=0x40;
   msc_data[0x805/RAMDISK_BLK_SIZ][0x805%RAMDISK_BLK_SIZ]=0x00;
   msc_data[0x806/RAMDISK_BLK_SIZ][0x806%RAMDISK_BLK_SIZ]=0x05;
   msc_data[0x807/RAMDISK_BLK_SIZ][0x807%RAMDISK_BLK_SIZ]=0xF0;
   msc_data[0x808/RAMDISK_BLK_SIZ][0x808%RAMDISK_BLK_SIZ]=0xFF;

   msc_data[0xC00/RAMDISK_BLK_SIZ][0xC00%RAMDISK_BLK_SIZ]=0xF8;
   msc_data[0xC01/RAMDISK_BLK_SIZ][0xC01%RAMDISK_BLK_SIZ]=0xFF;
   msc_data[0xC02/RAMDISK_BLK_SIZ][0xC02%RAMDISK_BLK_SIZ]=0xFF;
   msc_data[0xC03/RAMDISK_BLK_SIZ][0xC03%RAMDISK_BLK_SIZ]=0x03;
   msc_data[0xC04/RAMDISK_BLK_SIZ][0xC04%RAMDISK_BLK_SIZ]=0x40;
   msc_data[0xC05/RAMDISK_BLK_SIZ][0xC05%RAMDISK_BLK_SIZ]=0x00;
   msc_data[0xC06/RAMDISK_BLK_SIZ][0xC06%RAMDISK_BLK_SIZ]=0x05;
   msc_data[0xC07/RAMDISK_BLK_SIZ][0xC07%RAMDISK_BLK_SIZ]=0xF0;
   msc_data[0xC08/RAMDISK_BLK_SIZ][0xC08%RAMDISK_BLK_SIZ]=0xFF;     

	HAL_GPIO_WritePin(GPIOB, GPIO_PIN_13,GPIO_PIN_SET);	//CAN1_LED_OFF			
	HAL_GPIO_WritePin(GPIOB, GPIO_PIN_14,GPIO_PIN_SET);	//CAN2_LED_OFF
	
	 return lun == 0 ?(USBD_OK):(USBD_FAIL);
  /* USER CODE END 2 */
}

/**
  * @brief  .
  * @param  lun: .
  * @param  block_num: .
  * @param  block_size: .
  * @retval USBD_OK if all operations are OK else USBD_FAIL
  */
int8_t STORAGE_GetCapacity_FS(uint8_t lun, uint32_t *block_num, uint16_t *block_size)
{
  /* USER CODE BEGIN 3 */
  *block_num  = STORAGE_BLK_NBR;
  *block_size = STORAGE_BLK_SIZ;
  return (USBD_OK);
  /* USER CODE END 3 */
}

/**
  * @brief  .
  * @param  lun: .
  * @retval USBD_OK if all operations are OK else USBD_FAIL
  */
int8_t STORAGE_IsReady_FS(uint8_t lun)
{
  /* USER CODE BEGIN 4 */
	//HAL_GPIO_WritePin(GPIOB, GPIO_PIN_14,GPIO_PIN_RESET);	//CAN2_LED ON
  return (USBD_OK);
  /* USER CODE END 4 */
}

/**
  * @brief  .
  * @param  lun: .
  * @retval USBD_OK if all operations are OK else USBD_FAIL
  */
int8_t STORAGE_IsWriteProtected_FS(uint8_t lun)
{
  /* USER CODE BEGIN 5 */
  return (USBD_OK);
  /* USER CODE END 5 */
}

/**
  * @brief  .
  * @param  lun: .
  * @retval USBD_OK if all operations are OK else USBD_FAIL
  */
int8_t STORAGE_Read_FS(uint8_t lun, uint8_t *buf, uint32_t blk_addr, uint16_t blk_len)
{
  /* USER CODE BEGIN 6 */
	uint32_t n,i;
	for(n=0;n<blk_len;n++){
		for(i=0;i<STORAGE_BLK_SIZ;i++){	
			if(n*STORAGE_BLK_SIZ+i <RAMDISK_SIZE){				
			  buf[n*STORAGE_BLK_SIZ+i] = msc_data[blk_addr+n][i];
			}else{
				buf[n*STORAGE_BLK_SIZ+i] = 0;
			}
		}
		
	}
  return (USBD_OK);
  /* USER CODE END 6 */
}

/**
  * @brief  .
  * @param  lun: .
  * @retval USBD_OK if all operations are OK else USBD_FAIL
  */
int8_t STORAGE_Write_FS(uint8_t lun, uint8_t *buf, uint32_t blk_addr, uint16_t blk_len)
{
  /* USER CODE BEGIN 7 */
	static FLASH_EraseInitTypeDef EraseInitStruct;
	static uint32_t d1,d2,d3,d4,cnt,dis1,dis2,dis3=0;
	static uint32_t Address = ApplicationAddress;
	static uint32_t Address2 = ApplicationAddress2;
	static uint32_t Address3 = ApplicationAddress3;
	static uint32_t key = 0;
	uint32_t n,i;
	uint32_t PageError=0;
	
	uint32_t Data = 0;

	HAL_FLASH_Unlock();	
	
	for(n=0;n<blk_len;n++){
		for(i=0;i<STORAGE_BLK_SIZ;i++){			
				if(n*STORAGE_BLK_SIZ+i <RAMDISK_SIZE){				
					msc_data[blk_addr+n][i]=buf[n*STORAGE_BLK_SIZ+i];
				}else{
					
				}					
				
				d4 = d3;
				d3 = d2;
				d2 = d1;
				d1 = buf[n*STORAGE_BLK_SIZ+i];
				
				if(d1==0xD1 && d2 ==0xCC && d3==0xBB && d4 == 0xAA && !dis1){
						if(!dis1){
							dis1 = 1;
							dis2 = 0;
							dis3 = 0;
							cnt = 1;
							EraseInitStruct.TypeErase = FLASH_TYPEERASE_PAGES;
							EraseInitStruct.PageAddress = ApplicationAddress;
							EraseInitStruct.NbPages = (0x8010000 - ApplicationAddress) / FLASH_PAGE_SIZE;
							HAL_FLASH_Unlock();
							FLASH_WaitForLastOperation(1000);
							if (HAL_FLASHEx_Erase(&EraseInitStruct, &PageError) != HAL_OK){
								Error_Handler();
							}
							FLASH_WaitForLastOperation(1000);	
							
						}	
				}
				
				if(d1==0xD2 && d2 ==0xCC && d3==0xBB && d4 == 0xAA && !dis2){
						if(!dis2){
							dis1 = 0;
							dis2 = 1;
							dis3 = 0;
							cnt = 1;							
							EraseInitStruct.TypeErase = FLASH_TYPEERASE_PAGES;
							EraseInitStruct.PageAddress = ApplicationAddress2;
							EraseInitStruct.NbPages = (0x8010000 - ApplicationAddress2) / FLASH_PAGE_SIZE;
							HAL_FLASH_Unlock();
							FLASH_WaitForLastOperation(1000);
							if (HAL_FLASHEx_Erase(&EraseInitStruct, &PageError) != HAL_OK){
								Error_Handler();
							}
							FLASH_WaitForLastOperation(1000);
							
						}	
				}
				if(d1==0xDD && d2 ==0xCC && d3==0xBB && d4 == 0xAA && !dis3){
						if(!dis3){									
							dis1 = 0;
							dis2 = 0;
							dis3 = 1;
							cnt = 1;							
							EraseInitStruct.TypeErase = FLASH_TYPEERASE_PAGES;
							EraseInitStruct.PageAddress = ApplicationAddress3;
							EraseInitStruct.NbPages = (0x8010000 - ApplicationAddress3) / FLASH_PAGE_SIZE;
							HAL_FLASH_Unlock();
							FLASH_WaitForLastOperation(1000);
							if (HAL_FLASHEx_Erase(&EraseInitStruct, &PageError) != HAL_OK){								
								Error_Handler();
							}							
							FLASH_WaitForLastOperation(1000);
							
						}
					
				}
				
				
				if(cnt>=1){
					cnt++;
					
					if(dis1 && !dis2 && !dis3){
						if(cnt>=6 && ((cnt-6)%4==0)){								//Start Flash Write
							Data = (d1<<24)|(d2<<16)|(d3<<8)|(d4);
							FLASH_WaitForLastOperation(1000);
							if (HAL_FLASH_Program(FLASH_TYPEPROGRAM_WORD, Address, Data) == HAL_OK){
								Address = Address + 4;
								HAL_GPIO_WritePin(GPIOB, GPIO_PIN_13,GPIO_PIN_RESET);	//CAN1_LED ON								
							}else{								
								Error_Handler();	
							}
						}
					}
					
					if(dis2 && !dis1 && !dis3){
						if(cnt>=6 && ((cnt-6)%4==0)){								//Start Flash Write
							Data = (d1<<24)|(d2<<16)|(d3<<8)|(d4);
							if(Address2 < 0x8010000){
								FLASH_WaitForLastOperation(1000);
								if (HAL_FLASH_Program(FLASH_TYPEPROGRAM_WORD, Address2, Data) == HAL_OK){
									Address2 = Address2 + 4;		
									HAL_GPIO_WritePin(GPIOB, GPIO_PIN_14,GPIO_PIN_RESET);	//CAN2_LED ON
								}else{								
									Error_Handler();	
								}
							}
						}
					}
					
					if(dis3 && !dis1 && !dis2){
						if(cnt>=6 && ((cnt-6)%4==0)){								//Start Flash Write
							Data = (d1<<24)|(d2<<16)|(d3<<8)|(d4);
							if(cnt ==6) {key = Data;}
							if(Address3 < 0x8010000){								
								FLASH_WaitForLastOperation(1000);
								if (HAL_FLASH_Program(FLASH_TYPEPROGRAM_WORD, Address3, key) == HAL_OK){
										
									if(key == 0x8D3E15D1 &&  Address3 == 0x0800F800 && cnt==6)
										HAL_GPIO_WritePin(GPIOB, GPIO_PIN_14,GPIO_PIN_RESET);	//CAN2_LED ON
									
									Address3 = Address3 + 4;
								}else{								
									Error_Handler();	
								}
							}
						}
					}
				}			
		}
	}
	
	HAL_FLASH_Lock();	
  return (USBD_OK);
  /* USER CODE END 7 */
}

/**
  * @brief  .
  * @param  None
  * @retval .
  */
int8_t STORAGE_GetMaxLun_FS(void)
{
  /* USER CODE BEGIN 8 */
  return (STORAGE_LUN_NBR - 1);
  /* USER CODE END 8 */
}

/* USER CODE BEGIN PRIVATE_FUNCTIONS_IMPLEMENTATION */

/* USER CODE END PRIVATE_FUNCTIONS_IMPLEMENTATION */

/**
  * @}
  */

/**
  * @}
  */

/************************ (C) COPYRIGHT STMicroelectronics *****END OF FILE****/
